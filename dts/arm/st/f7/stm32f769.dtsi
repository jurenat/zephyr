/*
 * Copyright (c) 2018 Yurii Hamann
 *
 * SPDX-License-Identifier: Apache-2.0
 */

#include <st/f7/stm32f767.dtsi>
#include <zephyr/dt-bindings/mipi_dsi/mipi_dsi.h>

/ {
	soc {
		compatible = "st,stm32f769", "st,stm32f7", "simple-bus";

		mipi_dsi: dsihost@40016c00 {
			compatible = "st,stm32-mipi-dsi";
			#address-cells = <1>;
			#size-cells = <0>;
			reg = <0x40016c00 0x800>;
			clock-names = "dsiclk", "refclk", "pixelclk";
			clocks = <&rcc STM32_CLOCK(APB2, 27U)>,
				 <&rcc STM32_SRC_HSE NO_SEL>,
				 <&rcc STM32_SRC_PLL_R NO_SEL>;
			resets = <&rctl STM32_RESET(APB2, 27U)>;
			status = "disabled";
			phy-timings = <35 35 35 35 0 10>;
			/*test-pattern = <0>;*/
		};
	};

};
