## boards/shields/st_b_lcd40_dsi1_mb1166/boards/stm32f769i_disco.conf
```kconfig
# Copyright (c) 2023 bytes at work AG
# SPDX-License-Identifier: Apache-2.0

CONFIG_MEMC=y
CONFIG_STM32_LTDC_ARGB8888=y
CONFIG_HEAP_MEM_POOL_SIZE=65536
CONFIG_LV_Z_BITS_PER_PIXEL=32
#CONFIG_LV_COLOR_DEPTH_32=y
CONFIG_STM32_LTDC_FB_NUM=2
```
